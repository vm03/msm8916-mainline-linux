## Documentation/devicetree/bindings/iio/light/cm36652.txt
```
* Capella CM36652 I2C Proximity and Color Light sensor

Required properties:
- compatible: must be "capella,cm36652"
- reg: the I2C address of the device
- interrupts: interrupt-specifier for the sole interrupt
	      generated by the device
- vdd-supply: provides power for the IC
- vddio-supply: power for external pull-up
- vled-supply: regulator for the IR LED. IR_LED is a part
	      of the cm36652 for proximity detection.
	      As covered in ../../regulator/regulator.txt

Example:

	&blsp_i2c2 {
		/* ... */

		cm36652@60 {
			compatible = "capella,cm36652";
			reg = <0x60>;
			interrupt-parent = <&msmgpio>;
			interrupts = <113 IRQ_TYPE_EDGE_FALLING>;
			vdd-supply = <&pm8916_l17>;
			vddio-supply = <&pm8916_l5>;
			vled-supply = <&reg_proximity_vled>;
		};

		/* ... */
	};
```
